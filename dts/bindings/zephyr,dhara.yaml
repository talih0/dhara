## dts/bindings/zephyr,dhara.yaml
```yaml
include: base.yaml

compatible: "zephyr,dhara"

description: "Dahra nand flash translation layer"

properties:
  partition:
    type: phandle
    required: true
    description: A reference to the dhara system's partition.

  page-size:
    type: int
    required: true
    description: Block size for writing to the nand flash device.
```

## zephyr/Kconfig
```kconfig
config DHARA
	bool "Dhara Nand flash translation module"

module = DHARA
module-str = Dhara logging module
source "subsys/logging/Kconfig.template.log_config"
```
